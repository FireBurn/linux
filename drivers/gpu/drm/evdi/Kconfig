## drivers/gpu/drm/evdi/Kconfig
```kconfig
# SPDX-License-Identifier: GPL-2.0
config DRM_EVDI
	tristate "Extensible Virtual Display Interface (Rust)"
	depends on DRM
	depends on RUST
	select DRM_KMS_HELPER
	select RUST_DRM_GEM_SHMEM_HELPER
	help
	  Rust reimplementation of DisplayLink's EVDI: a virtual DRM/KMS display
	  whose framebuffer is pulled by a userspace client (DisplayLinkManager
	  via libevdi) rather than scanned out to local hardware. Cards are
	  created on demand through /sys/devices/evdi and can be bound to a USB
	  dock so they appear/disappear with it.

	  The module identifies itself to userspace as "evdi" for compatibility
	  with the existing libevdi / DisplayLinkManager stack.

	  To compile this as a module, choose M here: the module is called evdi.

	  If unsure, say N.

config DRM_EVDI_KUNIT_TEST
	bool "KUnit tests for the evdi driver"
	depends on DRM_EVDI && KUNIT
	help
	  Build evdi's colour-management unit tests into the driver. The tests
	  run when the driver is loaded, so this option is intended for driver
	  development and test kernels rather than normal use.

	  If in doubt, say N.
```

## drivers/gpu/drm/vino/Kconfig
```kconfig
# SPDX-License-Identifier: GPL-2.0
config DRM_VINO
	tristate "DisplayLink DL3 (Vino) open driver"
	depends on USB
	depends on DRM
	depends on RUST
	# CRYPTO_RSA lives under `if CRYPTO`, and RUST_DRM_GEM_SHMEM_HELPER depends on
	# MMU; inherit both dependencies here so the selects below cannot generate an
	# unmet-direct-dependency warning.
	depends on CRYPTO
	depends on MMU
	select DRM_KMS_HELPER
	select RUST_DRM_GEM_SHMEM_HELPER
	select CRYPTO_RSA
	select RUST_CRYPTO_RSA
	select RUST_CRYPTO_LIB_AES
	select RUST_CRYPTO_LIB_SHA256
	select FW_LOADER
	select RUST_FW_LOADER_ABSTRACTIONS
	select FW_UPLOAD
	help
	  Open in-kernel Rust driver for DisplayLink DL3 docks: the DL-3x00
	  port replicators, the Dell Universal Dock D6000 and other DL-6xxx
	  docks, and the DL-7400 quad-display docks. A dock is matched on its
	  USB function rather than on a product id, and identified from the
	  vendor descriptor it carries.

	  It binds the dock over USB, runs the HDCP 2.2 control plane, mode-set
	  and the Vino codec, and registers a DRM/KMS sink that scans out to the
	  dock's video endpoints.

	  To compile this as a module, choose M here: the module is called vino.

	  If unsure, say N.

config DRM_VINO_KUNIT_TEST
	bool "KUnit tests for the Vino driver"
	depends on DRM_VINO && KUNIT
	help
	  Build Vino's protocol, crypto and codec unit tests into the driver.
	  The tests run when the driver is loaded, so this option is intended
	  for driver development and test kernels rather than normal use.

	  If in doubt, say N.
```
